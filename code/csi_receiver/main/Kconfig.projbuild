## code/csi_receiver/sdkconfig.defaults
```kconfig
CONFIG_FREERTOS_HZ=1000

CONFIG_ESP32S3_DEFAULT_CPU_FREQ_240=y
CONFIG_ESP32S3_DEFAULT_CPU_FREQ_MHZ=240

CONFIG_ESP32_WIFI_CSI_ENABLED=y

CONFIG_SPIRAM=y

CONFIG_SPIRAM_MODE_OCT=y
CONFIG_SPIRAM_TYPE_AUTO=y

CONFIG_ESPTOOLPY_FLASHSIZE_16MB=y
CONFIG_ESPTOOLPY_FLASHSIZE="16MB"

CONFIG_PARTITION_TABLE_CUSTOM=y
CONFIG_PARTITION_TABLE_CUSTOM_FILENAME="partitions.csv"
CONFIG_PARTITION_TABLE_FILENAME="partitions.csv"
CONFIG_PARTITION_TABLE_OFFSET=0x8000
CONFIG_PARTITION_TABLE_MD5=y

# Default CSI Receiver Configuration
CONFIG_FRAMES_PER_SECOND=50
CONFIG_TIME_RANGE_TO_KEEP=30
CONFIG_PERFORM_OUTLIER_FILTERING=y
CONFIG_HAMPEL_WINDOW_SIZE=3
CONFIG_FFT_EVERY_X_SECONDS=10
CONFIG_MRC_PCA_ON_TIMER=y
CONFIG_MRC_PCA_EVERY_X_SECONDS=120
CONFIG_ENABLE_PEAK_VALLEY_AMPLITUDE_CRITERIUM=y
```

## code/csi_sender/main/Kconfig.projbuild
```kconfig
menu "CSI Sender Configuration"

    config FRAMES_PER_SECOND
        int "Frames per second"
        default 50
        range 0 1000
        help
            The number of Wi-Fi frames to send per second - this should then correspond to the number of CSI samples received at the receiver.

endmenu
```

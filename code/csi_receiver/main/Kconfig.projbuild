## code/csi_receiver/main/Kconfig.projbuild
```kconfig
menu "CSI Receiver Configuration"

    config PROCESS_CSI_FROM_FILE
        bool "Process CSI from file"
        default false
        help
            Whether to process CSI from a file named "csi_process.csv" on the sd card instead of processing received CSI. 

    config FRAMES_PER_SECOND
        int "Frames per second"
        default 50
        range 0 1000
        help
            The number of CSI frames received per second - this should correspond to the number of Wi-Fi frames the CSI sender sends each second.

    config TIME_RANGE_TO_KEEP
        int "Time range of samples to keep"
        default 30
        range 0 120
        help
            The time range of samples kept for processing in seconds.

    config CALCULATE_SSNR
        bool "Calculate SSNR"
        default true
        help
            Whether to calculate SSNR. Only use this to check the signal quality when setting up as it used quite a bit of RAM such that not all other features can be enabled.

    config PERFORM_OUTLIER_FILTERING
        bool "Perform outlier filtering"
        default true
        help
            Whether to filter outliers in the CSI amplitude using a Hampel filter.

    config HAMPEL_WINDOW_SIZE
        depends on PERFORM_OUTLIER_FILTERING
        int "Hampel filter window size"
        default 3
        help
            The number of samples on each side of the current sample that are considered in the hampel filter.

    config REMOVE_STATIC_COMPONENT
        bool "Remove static component"
        default true
        help
            Whether to remove the static CSI component from the amplitude before further processing. 

    config FFT_EVERY_X_SECONDS
        int "FFT every x seconds"
        default 10
        range 0 1000
        help
            The interval (in seconds) after which FFT rate estimations performed.

    config SUBCARRIER_SELECTION_INSTEAD_OF_FUSION
        bool "Subcarrier selection instead of fusion"
        default true
        help
            Whether to select one subcarrier to use based on the subcarrier amplitude variance instead of using MRC-PCA for subcarrier fusion.

    config SUBCARRIER_SELECTION_EVERY_X_SECONDS
        depends on SUBCARRIER_SELECTION_INSTEAD_OF_FUSION
        int "Subcarrier selection every X seconds"
        default 30
        range 0 1000
        help
            The interval (in seconds) after which to perform subcarrier selection based on the subcarrier amplitude variance.
       
    config MRC_PCA_ON_TIMER
            depends on !SUBCARRIER_SELECTION_INSTEAD_OF_FUSION
            bool "MRC-PCA on timer"
            default true
            help
                Whether to perform MRC-PCA every X seconds as if on a timer.

    config MRC_PCA_EVERY_X_SECONDS
        depends on MRC_PCA_ON_TIMER && !SUBCARRIER_SELECTION_INSTEAD_OF_FUSION
        int "MRC-PCA every x seconds"
        default 120
        range 0 1000
        help
            The interval (in seconds) after which the MRC-PCA is performed to calculate the weights for subcarrier fusion.

    config MRC_PCA_AFTER_MOVEMENT
        depends on !SUBCARRIER_SELECTION_INSTEAD_OF_FUSION
        bool "MRC-PCA after large movement"
        default false
        help
            Whether to perform MRC-PCA (calculating the coefficients for subcarrier fusion) after large movement was detected - if it hasn't been performed too recently.
    
    config MRC_PCA_ON_NEW_PRESENCE
        depends on !SUBCARRIER_SELECTION_INSTEAD_OF_FUSION
        bool "MRC-PCA on new presence"
        default false
        help
            Whether to perform MRC-PCA (calculating the coefficients for subcarrier fusion) after new presence was detected - if it hasn't been performed too recently.

    config MRC_PCA_MINIMUM_INTERVAL
        depends on !SUBCARRIER_SELECTION_INSTEAD_OF_FUSION
        depends on MRC_PCA_AFTER_MOVEMENT || MRC_PCA_ON_NEW_PRESENCE
        int "Minimum MRC-PCA interval"
        default 10
        range 0 1000
        help
            Minimum interval (in seconds) after which MRC-PCA can be performed again.

    config ENABLE_PEAK_VALLEY_AMPLITUDE_CRITERIUM
        bool "Enable peak/valley amplitude criterium"
        default true
        help
            Whether discard potential peaks/valleys due to a too large amplitude difference compared to previous POIs.

    config COLLECT_TRAINING_DATA_FOR_NN
        bool "Collect training data for NN"
        default true
        help
            Whether to collect training data (features) for a NN for performing sleep stage classification in a separate file.

    config RUN_INFERENCE
        bool "Run inference"
        default true
        help
            Whether to run inference.

    config NUMBER_OF_SAMPLES_FOR_NN_INPUT
        int "Number of samples for NN input"
        default 64
        help
            The number of samples of feature vectors to be used as input to the NN.

    config START_INFERENCE_AFTER_X_SECONDS
        depends on RUN_INFERENCE
        int "Start inference after x seconds"
        default 120
        range 0 1000
        help
            The interval (in seconds) after which inference (sleep stage classification) is run for the first time.
        
    config RUN_INFERENCE_EVERY_X_SECONDS
        depends on RUN_INFERENCE
        int "Run inference every x seconds"
        default 120
        range 0 1000
        help
            The interval (in seconds) after which is inference is run again.
        
        
    menu "Wi-Fi settings"
        config ESP_WIFI_SSID
            string "WiFi SSID"
            default "myssid"
            help
                SSID (network name) for the example to connect to.

        config ESP_WIFI_PASSWORD
            string "WiFi Password"
            default "mypassword"
            help
                WiFi password (WPA or WPA2) for the example to use.
        config ESP_WIFI_CHANNEL
            int "WiFi Channel"
            range 1 13
            default 1
            help
                WiFi channel (network channel) for the example to use.

        config ESP_MAX_STA_CONN
            int "Maximal STA connections"
            default 4
            help
                Max number of the STA connects to AP.
    endmenu

    menu "Logging Settings" 

        config SENSE_LOG_TO_SD
            bool "Log to SD card"
            default false
            help
                Enable logging to SD card. Which features are logged can be selected using the suboptions.

        config SENSE_LOG_TO_SERIAL
            bool "Log to serial"
            default false
            help
                Enable logging to serial. Which features are logged can be selected using the suboptions.

        config SENSE_LOG_TO_UDP
            bool "Log to UDP broadcast"
            default false
            help
                Enable logging to UDP broadcast. Which features are logged can be selected using the suboptions.

        config SENSE_LOG_DIFFERENT_THINGS_TO_DIFFERENT_OUTPUTS
            bool "Log different things to different outputs"
            default false
            help
                Enable logging different features to different outputs. Which features are logged to which output can be selected using the suboptions. Enabling this option but logging many of the same things to each output slows down processing, so it might make sense to just log everything you want to all outputs.

        menu "SD pins"
            visible if SENSE_LOG_TO_SD

            config SD_PIN_MISO
                int "MISO pin number"
                default 13

            config SD_PIN_MOSI
                int "MOSI pin number"
                default 11

            config SD_PIN_CLK
                int "CLK pin number"
                default 12

            config SD_PIN_CS
                int "CS pin number"
                default 46

        endmenu


        menu "Features to log to sd or all enabled outputs"
            visible if SENSE_LOG_TO_SD || ((SENSE_LOG_TO_SERIAL || SENSE_LOG_TO_UDP) && !SENSE_LOG_DIFFERENT_THINGS_TO_DIFFERENT_OUTPUTS)

            config SENSE_PRINT_CSI_SD
                bool "print CSI"
                default true
                help
                    Whether to print the received CSI to a file on the SD card (and other outputs if different logging is not enabled).

            config SENSE_PRINT_AMPLITUDES_SD
                bool "print amplitudes"
                default true
                help
                    Whether to print the amplitudes of the subcarriers to a file on the SD card (and other outputs if different logging is not enabled).

            config SENSE_PRINT_STI_SD
                bool "print sti value"
                default true
                help
                    Whether to print the STI value (proxy of presence/motion) to a file on the SD card (and other outputs if different logging is not enabled).

            config SENSE_PRINT_DETECTION_SD
                bool "print presence / movement detection results"
                default true
                help
                    Whether to print the presence / movement detection results (based on the sti being larger than the specific threshold) to a file on the SD card (and other outputs if different logging is not enabled).
            
            config SENSE_PRINT_THRESHOLDS_SD
                bool "print presence / movement thresholds"
                default true
                help
                    Whether to print the presence / movement detection thresholds and their F scores on the calibration data to a file on the SD card (and other outputs if different logging is not enabled).
                    
            config SENSE_PRINT_FUSED_HEART_SD
                bool "print fused heart amplitude value"
                default true
                help
                    Whether to print the amplitude value of the subcarriers fused for extracting heart features to a file on the SD card (and other outputs if different logging is not enabled).

            config SENSE_PRINT_FUSED_BREATH_SD
                bool "print fused breath amplitude value"
                default true
                help
                    Whether to print the amplitude value of the subcarriers fused for extracting breathing features to a file on the SD card (and other outputs if different logging is not enabled).
                
            config SENSE_PRINT_FILTERED_HEART_SD
                bool "print filtered heart value"
                default true
                help
                    Whether to print the bandpass filtered amplitude value of the subcarriers fused for extracting heart features to a file on the SD card (and other outputs if different logging is not enabled).
    
            config SENSE_PRINT_FILTERED_BREATH_SD
                bool "print filtered breath value"
                default true
                help
                    Whether to print the bandpass filtered amplitude value of the subcarriers fused for extracting breathing features to a file on the SD card (and other outputs if different logging is not enabled).
    
            config SENSE_PRINT_HEART_FEATURES_SD
                bool "print heart features"
                default true
                help
                    Whether to print the calculated heart features to a file on the SD card (and other outputs if different logging is not enabled).
    
            config SENSE_PRINT_BREATHING_FEATURES_SD
                bool "print breathing features"
                default true
                help
                    Whether to print the calculated breathing features to a file on the SD card (and other outputs if different logging is not enabled).
    
            config SENSE_PRINT_HEART_POI_SD
                bool "print heart poi"
                default true
                help
                    Whether to print whether a new POI (peak/valley) was detected in the filtered heart signal and the POI's attributes to a file on the SD card (and other outputs if different logging is not enabled).
            
            config SENSE_PRINT_BREATHING_POI_SD
                bool "print breathing poi"
                default true
                help
                    Whether to print whether a new POI (peak/valley) was detected in the filtered breathing signal and the POI's attributes to a file on the SD card (and other outputs if different logging is not enabled).
        
            config SENSE_PRINT_SLEEP_STAGE_CLASSIFICATION_SD
                depends on RUN_INFERENCE
                bool "print sleep stage classification"
                default true
                help
                    Whether to print the result of the classification to a file on the SD card (and other outputs if different logging is not enabled).

            config SENSE_PRINT_SSNR_SD
                depends on CALCULATE_SSNR
                bool "print SSNR"
                default true
                help
                    Whether to print the maximum SSNR value and corresponding subcarrier to a file on the SD card (and other outputs if different logging is not enabled).

        endmenu
        
        menu "Features to log to serial"
            visible if SENSE_LOG_TO_SERIAL && SENSE_LOG_DIFFERENT_THINGS_TO_DIFFERENT_OUTPUTS

            config SENSE_PRINT_CSI_S
                bool "print CSI"
                default true
                help
                    Whether to print the received CSI to serial.

            config SENSE_PRINT_AMPLITUDES_S
                bool "print amplitudes"
                default true
                help
                    Whether to print the amplitudes of the subcarriers to serial.

            config SENSE_PRINT_STI_S
                bool "print sti value"
                default true
                help
                    Whether to print the STI value (proxy of presence/motion) to serial.
            
            config SENSE_PRINT_DETECTION_S
                bool "print presence / movement detection results"
                default true
                help
                    Whether to print the presence / movement detection results (based on the sti being larger than the specific threshold) to serial.
            
            config SENSE_PRINT_THRESHOLDS_S
                bool "print presence / movement thresholds"
                default true
                help
                    Whether to print the presence / movement detection thresholds and their F scores on the calibration data to serial.
                                
            config SENSE_PRINT_FUSED_HEART_S
                bool "print fused heart amplitude value"
                default true
                help
                    Whether to print the amplitude value of the subcarriers fused for extracting heart features to serial.

            config SENSE_PRINT_FUSED_BREATH_S
                bool "print fused breath amplitude value"
                default true
                help
                    Whether to print the amplitude value of the subcarriers fused for extracting breathing features to serial.
                
            config SENSE_PRINT_FILTERED_HEART_S
                bool "print filtered heart value"
                default true
                help
                    Whether to print the bandpass filtered amplitude value of the subcarriers fused for extracting heart features to serial.
    
            config SENSE_PRINT_FILTERED_BREATH_S
                bool "print filtered breath value"
                default true
                help
                    Whether to print the bandpass filtered amplitude value of the subcarriers fused for extracting breathing features to serial.
    
            config SENSE_PRINT_HEART_FEATURES_S
                bool "print heart features"
                default true
                help
                    Whether to print the calculated heart features to serial.
    
            config SENSE_PRINT_BREATHING_FEATURES_S
                bool "print breathing features"
                default true
                help
                    Whether to print the calculated breathing features to serial.
    
            config SENSE_PRINT_HEART_POI_S
                bool "print heart poi"
                default true
                help
                    Whether to print whether a new POI (peak/valley) was detected in the filtered heart signal and the POI's attributes to serial.
            
            config SENSE_PRINT_BREATHING_POI_S
                bool "print breathing poi"
                default true
                help
                    Whether to print whether a new POI (peak/valley) was detected in the filtered breathing signal and the POI's attributes to serial.
            
            config SENSE_PRINT_SLEEP_STAGE_CLASSIFICATION_S
                depends on RUN_INFERENCE
                bool "print sleep stage classification"
                default true
                help
                    Whether to print the result of the classification to serial.

            config SENSE_PRINT_SSNR_S
                depends on CALCULATE_SSNR
                bool "print SSNR"
                default true
                help
                    Whether to print the maximum SSNR value and corresponding subcarrier to serial.
    
        endmenu

        menu "Features to log to UDP"
            visible if SENSE_LOG_TO_UDP && SENSE_LOG_DIFFERENT_THINGS_TO_DIFFERENT_OUTPUTS

            config SENSE_PRINT_CSI_U
                bool "print CSI"
                default true
                help
                    Whether to print the received CSI to UDP broadcast.

            config SENSE_PRINT_AMPLITUDES_U
                bool "print amplitudes"
                default true
                help
                    Whether to print the amplitudes of the subcarriers to UDP broadcast.

            config SENSE_PRINT_STI_U
                bool "print sti value"
                default true
                help
                    Whether to print the STI value (proxy of presence/motion) to UDP broadcast.
            
            config SENSE_PRINT_DETECTION_U
                bool "print presence / movement detection results"
                default true
                help
                    Whether to print the presence / movement detection results (based on the sti being larger than the specific threshold) to UDP broadcast.
            
            config SENSE_PRINT_THRESHOLDS_U
                bool "print presence / movement thresholds"
                default true
                help
                    Whether to print the presence / movement detection thresholds and their F scores on the calibration data to UDP broadcast.
                                
            config SENSE_PRINT_FUSED_HEART_U
                bool "print fused heart amplitude value"
                default true
                help
                    Whether to print the amplitude value of the subcarriers fused for extracting heart features to UDP broadcast.

            config SENSE_PRINT_FUSED_BREATH_U
                bool "print fused breath amplitude value"
                default true
                help
                    Whether to print the amplitude value of the subcarriers fused for extracting breathing features to UDP broadcast.
                
            config SENSE_PRINT_FILTERED_HEART_U
                bool "print filtered heart value"
                default true
                help
                    Whether to print the bandpass filtered amplitude value of the subcarriers fused for extracting heart features to UDP broadcast.
    
            config SENSE_PRINT_FILTERED_BREATH_U
                bool "print filtered breath value"
                default true
                help
                    Whether to print the bandpass filtered amplitude value of the subcarriers fused for extracting breathing features to UDP broadcast.
    
            config SENSE_PRINT_HEART_FEATURES_U
                bool "print heart features"
                default true
                help
                    Whether to print the calculated heart features to UDP broadcast.
    
            config SENSE_PRINT_BREATHING_FEATURES_U
                bool "print breathing features"
                default true
                help
                    Whether to print the calculated breathing features to UDP broadcast.
    
            config SENSE_PRINT_HEART_POI_U
                bool "print heart poi"
                default true
                help
                    Whether to print whether a new POI (peak/valley) was detected in the filtered heart signal and the POI's attributes to UDP broadcast.
            
            config SENSE_PRINT_BREATHING_POI_U
                bool "print breathing poi"
                default true
                help
                    Whether to print whether a new POI (peak/valley) was detected in the filtered breathing signal and the POI's attributes to UDP broadcast.
    
            config SENSE_PRINT_SLEEP_STAGE_CLASSIFICATION_U
                depends on RUN_INFERENCE
                bool "print sleep stage classification"
                default true
                help
                    Whether to print the result of the classification to UDP broadcast.        
            
            config SENSE_PRINT_SSNR_U
                depends on CALCULATE_SSNR
                bool "print SSNR"
                default true
                help
                    Whether to print the maximum SSNR value and corresponding subcarrier to UDP broadcast.
        endmenu
        
    endmenu
   
endmenu
```
